## conf/layer.conf
```bitbake
# Let bitbake find our .bbclass and .conf files
BBPATH .= ":${LAYERDIR}"

# Let bitbake know where to look for .bb and .bbappend files
BBFILES += "${LAYERDIR}/recipes-*/*/*.bb \
        ${LAYERDIR}/recipes-*/*/*.bbappend"


BBFILE_COLLECTIONS += "seco-bsp-release-imx8-3-0-0"
BBFILE_PATTERN_seco-bsp-release-imx8-3-0-0 := "^${LAYERDIR}/"
BBFILE_PRIORITY_seco-bsp-release-imx8-3-0-0 = "8"
LAYERSERIES_COMPAT_seco-bsp-release-imx8-3-0-0 = "sumo"
```

## conf/machine/seco-imx8mq-c12.conf
```bitbake
#@TYPE: Machine
#@NAME: seco-imx8mq-c12
#@SOC: i.MX8MQ
#@DESCRIPTION: Machine configuration for seco-imx8mq-c12
#@MAINTAINER: Mathanraj Murugan <mathan.raj@seco.com>

MACHINEOVERRIDES =. "mx8:mx8m:mx8mq:"

require conf/machine/include/imx-base.inc
require conf/machine/include/arm/arch-arm64.inc

MACHINE_FEATURES += " pci wifi bluetooth optee qca6174"

IMAGE_BOOTFILES_DEPENDS += " imx-m4-demos:do_deploy"

IMAGE_BOOTFILES += "imx8mq_m4_TCM_hello_world.bin imx8mq_m4_TCM_rpmsg_lite_pingpong_rtos_linux_remote.bin imx8mq_m4_TCM_rpmsg_lite_str_echo_rtos.bin"

PREFERRED_PROVIDER_virtual/kernel ?= "linux-seco"
PREFERRED_PROVIDER_virtual/kernel_mx8mq = "linux-seco"

KERNEL_DEVICETREE ?= "seco/seco-imx8mq-c12.dtb"
KERNEL_OVERLAYDEVICETREE += "seco/overlays/seco-imx8mq-c12-dual-display.dtbo seco/overlays/seco-imx8mq-c12-lcdif-sn65dsi84.dtbo seco/overlays/seco-imx8mq-c12-wilink.dtbo seco/overlays/seco-imx8mq-c12-dcss-sn65dsi84.dtbo seco/overlays/seco-imx8mq-c12-can-rtc.dtbo"

PREFERRED_PROVIDER_u-boot = "u-boot-seco"
PREFERRED_PROVIDER_u-boot_mx8mq = "u-boot-seco"
PREFERRED_PROVIDER_virtual/bootloader = "u-boot-seco"
PREFERRED_PROVIDER_virtual/bootloader_mx8mq = "u-boot-seco"

UBOOT_CONFIG ??= "sd"
UBOOT_CONFIG[sd] = "seco_imx8mq_c12_defconfig,sdcard"
SPL_BINARY = "spl/u-boot-spl.bin"

DDR_FIRMWARE_NAME = "lpddr4_pmu_train_1d_imem.bin lpddr4_pmu_train_1d_dmem.bin lpddr4_pmu_train_2d_imem.bin lpddr4_pmu_train_2d_dmem.bin"

UBOOT_DTB_NAME = "seco-imx8mq-c12.dtb"

IMXBOOT_TARGETS = "flash_evk"

IMAGE_BOOTLOADER = "imx-boot"

SERIAL_CONSOLE = "115200 ttymxc0"

BOOT_SPACE = "65536"

LOADADDR = ""
UBOOT_SUFFIX = "bin"
UBOOT_MAKE_TARGET = ""
IMX_BOOT_SEEK = "33"

OPTEE_BIN_EXT = "8mq"
PLATFORM_FLAVOR_seco-imx8mq-c12 = "mx8mqevk"
```

## conf/machine/seco-imx8mq-c25.conf
```bitbake
#@TYPE: Machine
#@NAME: seco-imx8mq-c25
#@SOC: i.MX8MQ
#@DESCRIPTION: Machine configuration for seco-imx8mq-c25
#@MAINTAINER: Mathanraj Murugan <mathan.raj@seco.com>

MACHINEOVERRIDES =. "mx8:mx8m:mx8mq:"

require conf/machine/include/imx-base.inc
require conf/machine/include/arm/arch-arm64.inc

MACHINE_FEATURES += " pci wifi bluetooth optee qca6174"

IMAGE_BOOTFILES_DEPENDS += " imx-m4-demos:do_deploy"

IMAGE_BOOTFILES += "imx8mq_m4_TCM_hello_world.bin imx8mq_m4_TCM_rpmsg_lite_pingpong_rtos_linux_remote.bin imx8mq_m4_TCM_rpmsg_lite_str_echo_rtos.bin"

PREFERRED_PROVIDER_virtual/kernel ?= "linux-seco"
PREFERRED_PROVIDER_virtual/kernel_mx8mq = "linux-seco"

KERNEL_DEVICETREE ?= "seco/seco-imx8mq-c25.dtb"
KERNEL_OVERLAYDEVICETREE += "seco/overlays/seco-imx8mq-c25-dual-display.dtbo seco/overlays/seco-imx8mq-c25-lcdif-sn65dsi84.dtbo seco/overlays/seco-imx8mq-c25-dcss-sn65dsi84.dtbo seco/overlays/seco-imx8mq-c25-dcss-sn65dsi86.dtbo"

PREFERRED_PROVIDER_u-boot = "u-boot-seco"
PREFERRED_PROVIDER_u-boot_mx8mq = "u-boot-seco"
PREFERRED_PROVIDER_virtual/bootloader = "u-boot-seco"
PREFERRED_PROVIDER_virtual/bootloader_mx8mq = "u-boot-seco"

UBOOT_CONFIG ??= "sd"
UBOOT_CONFIG[sd] = "seco_imx8mq_c25_defconfig,sdcard"
SPL_BINARY = "spl/u-boot-spl.bin"

DDR_FIRMWARE_NAME = "ddr4_dmem_1d.bin ddr4_imem_1d.bin ddr4_dmem_2d.bin ddr4_imem_2d.bin"
 
UBOOT_DTB_NAME = "seco-imx8mq-c25.dtb"

IMXBOOT_TARGETS = "flash_ddr4_val"

IMAGE_BOOTLOADER = "imx-boot"

SERIAL_CONSOLE = "115200 ttymxc0"

BOOT_SPACE = "65536"

LOADADDR = ""
UBOOT_SUFFIX = "bin"
UBOOT_MAKE_TARGET = ""
IMX_BOOT_SEEK = "33"

OPTEE_BIN_EXT = "8mq"
PLATFORM_FLAVOR_seco-imx8mq-c25 = "mx8mqevk"
```
